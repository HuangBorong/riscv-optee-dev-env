## config/opensbi/qemu_virt_optee_defconfig
```kconfig
#
# Platform Options
#
CONFIG_PLATFORM_GENERIC=y
CONFIG_PLATFORM_GENERIC_NAME="Generic"
CONFIG_PLATFORM_GENERIC_MAJOR_VER=0
CONFIG_PLATFORM_GENERIC_MINOR_VER=1
# CONFIG_PLATFORM_ALLWINNER_D1 is not set
# CONFIG_PLATFORM_ANDES_AE350 is not set
# CONFIG_PLATFORM_RENESAS_RZFIVE is not set
# CONFIG_PLATFORM_SIFIVE_FU540 is not set
# CONFIG_PLATFORM_SOPHGO_SG2042 is not set
# CONFIG_PLATFORM_STARFIVE_JH7110 is not set
# CONFIG_PLATFORM_THEAD is not set
# CONFIG_ANDES_PMA is not set
# CONFIG_ANDES_SBI is not set
# CONFIG_ANDES_PMU is not set
# CONFIG_THEAD_C9XX_PMU is not set
# CONFIG_THEAD_C9XX_ERRATA is not set
# end of Platform Options

#
# Generic SBI Support
#
CONFIG_CONSOLE_EARLY_BUFFER_SIZE=256
# CONFIG_SBI_ECALL_TIME is not set
# CONFIG_SBI_ECALL_RFENCE is not set
# CONFIG_SBI_ECALL_IPI is not set
CONFIG_SBI_ECALL_HSM=y
# CONFIG_SBI_ECALL_SRST is not set
# CONFIG_SBI_ECALL_SUSP is not set
# CONFIG_SBI_ECALL_PMU is not set
CONFIG_SBI_ECALL_DBCN=y
# CONFIG_SBI_ECALL_CPPC is not set
# CONFIG_SBI_ECALL_FWFT is not set
# CONFIG_SBI_ECALL_LEGACY is not set
# CONFIG_SBI_ECALL_VENDOR is not set
# CONFIG_SBI_ECALL_DBTR is not set
# CONFIG_SBIUNIT is not set
# CONFIG_SBI_ECALL_SSE is not set
# CONFIG_SBI_ECALL_MPXY is not set
# end of Generic SBI Support

#
# Utils and Drivers Support
#

#
# CPPC Device Support
#
# CONFIG_FDT_CPPC is not set
# end of CPPC Device Support

CONFIG_FDT=y
CONFIG_FDT_DOMAIN=y
CONFIG_FDT_PMU=y
# CONFIG_FDT_FIXUPS_PRESERVE_PMU_NODE is not set

#
# GPIO Support
#
# CONFIG_FDT_GPIO is not set
# CONFIG_GPIO is not set
# end of GPIO Support

#
# HSM Device Support
#
# CONFIG_FDT_HSM is not set
# end of HSM Device Support

#
# I2C Support
#
# CONFIG_FDT_I2C is not set
# CONFIG_I2C_DW is not set
# CONFIG_I2C is not set
# end of I2C Support

#
# IPI Device Support
#
CONFIG_FDT_IPI=y
CONFIG_FDT_IPI_MSWI=y
# CONFIG_FDT_IPI_PLICSW is not set
CONFIG_IPI_MSWI=y
# CONFIG_IPI_PLICSW is not set
# end of IPI Device Support

#
# Interrupt Controller Support
#
CONFIG_FDT_IRQCHIP=y
CONFIG_FDT_IRQCHIP_APLIC=y
#CONFIG_FDT_IRQCHIP_IMSIC=y
#CONFIG_FDT_IRQCHIP_PLIC=y
CONFIG_IRQCHIP_APLIC=y
#CONFIG_IRQCHIP_IMSIC=y
#CONFIG_IRQCHIP_PLIC=y
# end of Interrupt Controller Support

CONFIG_LIBFDT=y

#
# Mailbox Support
#
# CONFIG_FDT_MAILBOX is not set
# CONFIG_RPMI_MAILBOX is not set
# CONFIG_MAILBOX is not set
# end of Mailbox Support

#
# Regmap Support
#
# CONFIG_FDT_REGMAP is not set
# CONFIG_REGMAP is not set
# end of Regmap Support

#
# System Reset Support
#
# CONFIG_FDT_RESET is not set
# end of System Reset Support

#
# Serial Device Support
#
CONFIG_FDT_SERIAL=y
# CONFIG_FDT_SERIAL_CADENCE is not set
# CONFIG_FDT_SERIAL_GAISLER is not set
# CONFIG_FDT_SERIAL_HTIF is not set
# CONFIG_FDT_SERIAL_RENESAS_SCIF is not set
# CONFIG_FDT_SERIAL_SHAKTI is not set
# CONFIG_FDT_SERIAL_SIFIVE is not set
# CONFIG_FDT_SERIAL_LITEX is not set
CONFIG_FDT_SERIAL_UART8250=y
# CONFIG_FDT_SERIAL_XILINX_UARTLITE is not set
# CONFIG_SERIAL_CADENCE is not set
# CONFIG_SERIAL_GAISLER is not set
# CONFIG_SERIAL_RENESAS_SCIF is not set
# CONFIG_SERIAL_SHAKTI is not set
# CONFIG_SERIAL_SIFIVE is not set
# CONFIG_SERIAL_LITEX is not set
CONFIG_SERIAL_UART8250=y
# CONFIG_SERIAL_XILINX_UARTLITE is not set
# CONFIG_SERIAL_SEMIHOSTING is not set
# end of Serial Device Support

#
# System Suspend Support
#
# CONFIG_FDT_SUSPEND is not set
# end of System Suspend Support

#
# System Device Support
#
# CONFIG_SYS_ATCSMU is not set
# CONFIG_SYS_HTIF is not set
# end of System Device Support

#
# Timer Device Support
#
CONFIG_FDT_TIMER=y
CONFIG_FDT_TIMER_MTIMER=y
# CONFIG_FDT_TIMER_PLMT is not set
CONFIG_TIMER_MTIMER=y
# CONFIG_TIMER_PLMT is not set
# end of Timer Device Support

#
# MPXY Device Support
#
# CONFIG_FDT_MPXY is not set
# end of MPXY Device Support
# end of Utils and Drivers Support
```
